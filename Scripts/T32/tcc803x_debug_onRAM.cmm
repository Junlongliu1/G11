//===========================================================================
//
//                       Load Bootlaoder for TCC802x (A7)
//
//                        EDIT HISTORY FOR MODULE
//
//---------------------------------------------------------------------------
// version     who      history
//---------------------------------------------------------------------------
// 160727    Sangwon    Create file
//===========================================================================


system.option rb on
system.option.mmu off
system.option.enreset off
system.option.trst on
system.jtagclock 10mhz

sys.cpu CortexR5
sys.CONFIG.DEBUGACCESSPORT 1
sys.CONFIG.AHBACCESSPORT 0
sys.config corebase	0x80410000
sys.m.prepare

; initialize RTOS support
cd C:\T32\demo\arm\kernel\ucos-iii

print "initializing µC/OS-II support..."
TASK.CONFIG ucos3          ; load µC/OS-II Awareness (ucos.t32)
MENU.ReProgram ucos3       ; load µC/OS-II Menu (ucos.men)
HELP.FILTER.Add rtosucos3   ; add ucos awareness manual to help filter

D.S EZAHB:0x14400014 %LE %Long 0x02000000
D.A EZAHB:0xF1000000 wfi
D.S EZAHB:0x17000004 %LE %Long 0xFFFFFFFF

sys.m.a

if run()
	Break
cd Y:\work\micom_src\build\tcc803x
d.load.elf output/boot /RELPATH /PATH ./

data.list

enddo
